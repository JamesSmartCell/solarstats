## HALite/firmware/c6-radio/main/Kconfig.projbuild
```kconfig
menu "HALite C6 radio"

    config ZBGW_WIFI_SSID
        string "WiFi SSID"
        default "YOUR_WIFI_SSID"

    config ZBGW_WIFI_PASSWORD
        string "WiFi password"
        default "YOUR_WIFI_PASSWORD"

    config ZBGW_MQTT_HOST
        string "MQTT broker hostname or IP (ESPHome ingest)"
        default ""
        help
            LAN broker for ESPHome devices. Empty disables the MQTT client.
            Zigbee still reports to P4 over UART IPC.

    config ZBGW_MQTT_PORT
        int "MQTT broker port"
        range 1 65535
        default 1883

    config ZBGW_MQTT_USERNAME
        string "MQTT username"
        default ""

    config ZBGW_MQTT_PASSWORD
        string "MQTT password"
        default ""

    config ZBGW_MQTT_TOPIC_PREFIX
        string "Legacy topic prefix (unused for HA discovery)"
        default "halite-c6"

    config ZBGW_PRIMARY_CHANNEL
        int "Zigbee primary channel"
        range 11 26
        default 15

    config ZBGW_SECONDARY_CHANNEL_MASK
        hex "Zigbee secondary channel mask"
        default 0x07FFF800

    config ZBGW_PERMIT_JOIN_SECONDS
        int "Permit-join window (seconds)"
        range 1 254
        default 180

    config ZBGW_LED_GPIO
        int "Status LED GPIO"
        default 15

    config ZBGW_BOOT_GPIO
        int "BOOT / permit-join button GPIO"
        default 9

    config ZBGW_MAX_CHILDREN
        int "Max Zigbee children"
        range 1 32
        default 16

    config ZBGW_ZIGBEE_ONLY_DIAG
        bool "Zigbee-only diagnostic (unused in HALite app_main)"
        default n

    config ZBGW_PAIR_BEFORE_WIFI
        bool "Open permit-join before WiFi on boot"
        default n

    config ZBGW_PAIR_BEFORE_WIFI_SECONDS
        int "Pre-WiFi pairing window (seconds)"
        depends on ZBGW_PAIR_BEFORE_WIFI
        range 30 254
        default 180

    config ZBGW_DEV_PAIR_TEST
        bool "Run pair+toggle soak test before WiFi"
        default n

    config HALITE_ESP_HOSTED
        bool "ESP-Hosted slave (SDIO Wi-Fi for the P4)"
        default n
        help
            C6 becomes the hosted radio. The P4 associates and gets the LAN
            IP. Do not also run C6 wifi_net (one STA). Flash both images
            together. P4 will reset this chip on GPIO54 at hosted start.

    config HALITE_IPC_UART_NUM
        int "IPC UART number"
        range 0 2
        default 0
        help
            UART0 is C6_TXD/C6_RXD on the P4-M3 header (GPIO16/17).
            Console is USB Serial/JTAG so this port can be the P4 link.

    config HALITE_IPC_TX_GPIO
        int "IPC UART TX GPIO (C6 -> P4)"
        default 16

    config HALITE_IPC_RX_GPIO
        int "IPC UART RX GPIO (P4 -> C6)"
        default 17

    config HALITE_IPC_BAUD
        int "IPC UART baud"
        default 921600

    config HALITE_ESPHOME_1_ENTITY_ID
        string "ESPHome entity 1 id"
        default ""
        help
            Example: switch.bench_lamp

    config HALITE_ESPHOME_1_NODE
        string "ESPHome entity 1 node name"
        default ""

    config HALITE_ESPHOME_1_STATE_TOPIC
        string "ESPHome entity 1 state topic"
        default ""

    config HALITE_ESPHOME_1_CMD_TOPIC
        string "ESPHome entity 1 command topic"
        default ""

    config HALITE_ESPHOME_2_ENTITY_ID
        string "ESPHome entity 2 id"
        default ""

    config HALITE_ESPHOME_2_NODE
        string "ESPHome entity 2 node name"
        default ""

    config HALITE_ESPHOME_2_STATE_TOPIC
        string "ESPHome entity 2 state topic"
        default ""

    config HALITE_ESPHOME_2_CMD_TOPIC
        string "ESPHome entity 2 command topic"
        default ""

endmenu
```

## HALite/firmware/c6-radio/sdkconfig.defaults
```kconfig
#
# Partition Table
#
CONFIG_PARTITION_TABLE_CUSTOM=y
CONFIG_PARTITION_TABLE_CUSTOM_FILENAME="partitions.csv"
CONFIG_PARTITION_TABLE_OFFSET=0x8000

#
# Zigbee
#
CONFIG_ZB_ENABLED=y

#
# Wi-Fi / IEEE 802.15.4 coexistence (ESP32-C6)
#
CONFIG_ESP_COEX_SW_COEXIST_ENABLE=y
CONFIG_ESP_WIFI_SOFTAP_SUPPORT=n

#
# FreeRTOS
#
CONFIG_FREERTOS_HZ=1000

#
# mbedTLS — keep size down; LAN MQTT without TLS by default
#
CONFIG_MBEDTLS_AES_C=y
CONFIG_MBEDTLS_CCM_C=y
CONFIG_MBEDTLS_GCM_C=n
CONFIG_MBEDTLS_CMAC_C=n
CONFIG_MBEDTLS_SHA512_C=n
CONFIG_MBEDTLS_ECP_DP_SECP384R1_ENABLED=n
CONFIG_MBEDTLS_ECP_DP_SECP521R1_ENABLED=n
CONFIG_MBEDTLS_ECP_DP_SECP256K1_ENABLED=n
CONFIG_MBEDTLS_ECP_DP_BP256R1_ENABLED=n
CONFIG_MBEDTLS_ECP_DP_BP384R1_ENABLED=n
CONFIG_MBEDTLS_ECP_DP_BP512R1_ENABLED=n
CONFIG_MBEDTLS_KEY_EXCHANGE_RSA=n
CONFIG_MBEDTLS_KEY_EXCHANGE_RSA_PSK=n
CONFIG_MBEDTLS_KEY_EXCHANGE_ECDHE_RSA=n

#
# MQTT
#
CONFIG_MQTT_PROTOCOL_311=y
CONFIG_MQTT_TRANSPORT_SSL=n
CONFIG_MQTT_TRANSPORT_WEBSOCKET=n
CONFIG_MQTT_TRANSPORT_WEBSOCKET_SECURE=n

CONFIG_ZBGW_PRIMARY_CHANNEL=15
CONFIG_ZBGW_PERMIT_JOIN_SECONDS=180
CONFIG_ZBGW_LED_GPIO=15
CONFIG_ZBGW_BOOT_GPIO=9
CONFIG_ZBGW_MQTT_PORT=1883
CONFIG_ZBGW_MQTT_TOPIC_PREFIX="halite-c6"
CONFIG_HALITE_IPC_UART_NUM=0
CONFIG_HALITE_IPC_TX_GPIO=16
CONFIG_HALITE_IPC_RX_GPIO=17
CONFIG_HALITE_IPC_BAUD=921600
# Our app_main owns boot. Hosted slave is a component, not the whole image.
# CONFIG_ESP_HOSTED_COPROCESSOR_APP_MAIN is not set
# CONFIG_HALITE_ESP_HOSTED is not set
CONFIG_ESP_CONSOLE_USB_SERIAL_JTAG=y
# CONFIG_ESP_CONSOLE_UART_DEFAULT is not set
```

## HALite/firmware/p4-hub/main/Kconfig.projbuild
```kconfig
menu "HALite P4 hub"

    config HALITE_IPC_UART_NUM
        int "IPC UART number"
        range 0 2
        default 1
        help
            UART used to talk to the C6. Keep USB console on a different port.

    config HALITE_IPC_TX_GPIO
        int "IPC UART TX GPIO (P4 -> C6 RX)"
        default 4

    config HALITE_IPC_RX_GPIO
        int "IPC UART RX GPIO (C6 TX -> P4)"
        default 5

    config HALITE_IPC_BAUD
        int "IPC UART baud"
        default 921600

    config HALITE_API_TOKEN
        string "Optional bearer token (empty = open LAN)"
        default ""

    config HALITE_ESP_HOSTED
        bool "ESP-Hosted: C6 radio gives the P4 a LAN IP (SDIO)"
        default n
        help
            P4 drives Wi-Fi over the PCB SDIO link. httpd then binds a
            192.168.50.x address. Requires the C6 image built with
            HALITE_ESP_HOSTED. Pulses C6 reset on GPIO54 at start.
            Keep UART jumpers until IPC moves to hosted custom-data.

    config HALITE_WIFI_SSID
        string "LAN SSID (hosted STA)"
        depends on HALITE_ESP_HOSTED
        default "YOUR_WIFI_SSID"

    config HALITE_WIFI_PASSWORD
        string "LAN password (hosted STA)"
        depends on HALITE_ESP_HOSTED
        default "YOUR_WIFI_PASSWORD"

    config HALITE_USB_NCM
        bool "USB-NCM gadget so the PC can poll the HTTP API"
        default y
        help
            Presents the P4 USB-OTG port as Ethernet. The hub is 192.168.4.1.
            Use the native USB-OTG connector, not the CH340 UART (COM22).
            Turn this off once hosted LAN is up (two default routes).

    config HALITE_P4_ETHERNET
        bool "Start Ethernet + HTTP UI (P4 Function EV-style)"
        default n
        help
            Enable if the P4 board has a wired Ethernet PHY. Otherwise use
            USB NCM or the USB serial console (entities / permit / toggle).

    config HALITE_ETH_PHY_ADDR
        int "Ethernet PHY address"
        depends on HALITE_P4_ETHERNET
        default 1

    config HALITE_ETH_MDC_GPIO
        int "Ethernet MDC GPIO"
        depends on HALITE_P4_ETHERNET
        default 31

    config HALITE_ETH_MDIO_GPIO
        int "Ethernet MDIO GPIO"
        depends on HALITE_P4_ETHERNET
        default 52

    config HALITE_ETH_RST_GPIO
        int "Ethernet PHY reset GPIO (-1 = unused)"
        depends on HALITE_P4_ETHERNET
        default 51

endmenu
```

## HALite/firmware/p4-hub/sdkconfig.defaults
```kconfig
CONFIG_FREERTOS_HZ=1000
CONFIG_ESP_MAIN_TASK_STACK_SIZE=8192
CONFIG_HTTPD_WS_SUPPORT=y
CONFIG_HTTPD_MAX_REQ_HDR_LEN=1024
CONFIG_TINYUSB_NET_MODE_NCM=y
CONFIG_LWIP_DHCPS=y
CONFIG_HALITE_USB_NCM=y
# CONFIG_HALITE_ESP_HOSTED is not set
# CONFIG_HALITE_P4_ETHERNET is not set
CONFIG_HALITE_IPC_UART_NUM=1
CONFIG_HALITE_IPC_TX_GPIO=4
CONFIG_HALITE_IPC_RX_GPIO=5
CONFIG_HALITE_IPC_BAUD=921600
```

## zigbee-gateway/main/Kconfig.projbuild
```kconfig
menu "Zigbee Gateway Configuration"

    config ZBGW_WIFI_SSID
        string "WiFi SSID (setup form default)"
        default "YOUR_WIFI_SSID"
        help
            Prefills the ZIGBEE_SETUP form only. Never auto-joins.
            If NVS has no stored network, the SoftAP portal always opens.

    config ZBGW_WIFI_PASSWORD
        string "WiFi password (setup form default)"
        default "YOUR_WIFI_PASSWORD"
        help
            Prefills the setup form only. Runtime password is stored in NVS.

    config ZBGW_MQTT_HOST
        string "MQTT broker hostname or IP (seed only)"
        default "192.168.50.41"
        help
            Seed for NVS / the setup form. Runtime host is stored in NVS.
            Empty or unreachable hosts trigger a sequential LAN scan of
            port 1883 on the STA /24. Prefer a LAN IP on ESP32-C6 — .local
            mDNS is unreliable with Zigbee Wi-Fi coexistence.

    config ZBGW_MQTT_PORT
        int "MQTT broker port"
        range 1 65535
        default 1883

    config ZBGW_MQTT_USERNAME
        string "MQTT username (seed only)"
        default "zigbee-gw"
        help
            Seed only. Runtime username is stored in NVS.

    config ZBGW_MQTT_PASSWORD
        string "MQTT password (seed only)"
        default "change-me"
        help
            Seed only. Runtime password is stored in NVS.

    config ZBGW_SETUP_AP_SSID
        string "First-boot setup SoftAP name"
        default "ZBGW-SETUP"
        help
            Open AP when NVS has no Wi-Fi credentials.

    config ZBGW_OTA_URL
        string "HTTPS OTA firmware URL"
        default "https://homesolar.percolate.one/fw/zigbee-gateway.bin"
        help
            Public HTTPS URL for zigbee-gateway.bin on solarstats
            (homesolar). Same image is used for every gateway; Wi-Fi
            and MQTT stay in NVS across updates.

    config ZBGW_DIAG_URL
        string "Anonymous diagnostics HTTPS URL"
        default "https://homesolar.percolate.one/api/diag/zbgw"
        help
            POST target for failures, boot, and hourly health. Only used
            when the setup checkbox "Allow anonymous diagnostics" is on
            (default). No Wi-Fi or MQTT passwords are sent.

    config ZBGW_DIAG_TOKEN
        string "Diagnostics product token"
        default "zbgw-anon-v1"
        help
            Sent as X-ZBGW-Diag. Must match solarstats ZBGW_DIAG_TOKEN.

    config ZBGW_OTA_CHECK_ON_BOOT
        bool "Auto-check OTA (~90s after Wi-Fi, then every 12h)"
        default y
        help
            Compare the hosted image version to this build using dotted
            numbers (1.2.10 > 1.2.9). Flash only if the remote version is
            higher. Same or older images are skipped. MQTT …/bridge/ota
            still forces a check.

    config ZBGW_MQTT_TOPIC_PREFIX
        string "MQTT topic prefix"
        default "zigbee-gw"
        help
            First path segment. The STA MAC is appended at runtime
            (zigbee-gw/<mac>/...) so several C6s can share one broker.

    config ZBGW_PRIMARY_CHANNEL
        int "Zigbee primary channel"
        range 11 26
        default 15
        help
            Prefer channels that do not overlap your 2.4 GHz Wi-Fi
            (avoid Zigbee 11-14 near Wi-Fi 1, 16-19 near Wi-Fi 6, 21-24 near Wi-Fi 11).
            Channel 15 or 25 is often a good starting point.

    config ZBGW_SECONDARY_CHANNEL_MASK
        hex "Zigbee secondary channel mask"
        default 0x07FFF800
        help
            Fallback channel mask if formation on the primary channel fails.

    config ZBGW_PERMIT_JOIN_SECONDS
        int "Permit-join window (seconds)"
        range 1 254
        default 30
        help
            Exclusive pairing window. Wi-Fi is down for this time, or until
            a device announces — whichever is first.

    config ZBGW_LED_GPIO
        int "Status LED GPIO"
        default 15
        help
            FireBeetle 2 ESP32-C6 onboard LED is GPIO15.

    config ZBGW_BOOT_GPIO
        int "BOOT / permit-join button GPIO"
        default 9
        help
            FireBeetle 2 ESP32-C6 BOOT button is GPIO9 (active low).

    config ZBGW_MAX_CHILDREN
        int "Max Zigbee children"
        range 1 32
        default 16

    config ZBGW_ZIGBEE_ONLY_DIAG
        bool "Zigbee-only join diagnostic (no WiFi/MQTT)"
        default n
        help
            Never start WiFi or MQTT. Form the Zigbee network, open permit-join,
            and wait for Device announce. Use to test whether the 802.15.4 radio
            can hear plugs at all.

    config ZBGW_PAIR_BEFORE_WIFI
        bool "Open permit-join before WiFi on boot"
        default n
        depends on !ZBGW_ZIGBEE_ONLY_DIAG
        help
            After Zigbee forms, open a pairing window with WiFi still down so
            the C6 RF is exclusive. Best for stubborn plugs. Disable once
            pairing is reliable.

    config ZBGW_PAIR_BEFORE_WIFI_SECONDS
        int "Pre-WiFi pairing window (seconds)"
        depends on ZBGW_PAIR_BEFORE_WIFI
        range 30 254
        default 180

    config ZBGW_SERIAL_LOG
        bool "USB serial logging (debug build)"
        default n
        help
            Off for a release image: ESP_LOG is compiled out / muted.
            Anonymous diagnostics HTTP still runs. Enable for USB
            monitor (idf.py -DZBGW_DEBUG=1 reconfigure).

    config ZBGW_DEV_PAIR_TEST
        bool "Run pair+toggle soak test before WiFi"
        default n
        help
            After Zigbee forms, pause and open permit-join, wait for an On/Off
            plug, then toggle it. Keep off for normal gateway use.

endmenu
```

## zigbee-gateway/sdkconfig.defaults
```kconfig
#
# Partition Table
#
CONFIG_PARTITION_TABLE_CUSTOM=y
CONFIG_PARTITION_TABLE_CUSTOM_FILENAME="partitions.csv"
CONFIG_PARTITION_TABLE_OFFSET=0x8000

#
# Zigbee
#
CONFIG_ZB_ENABLED=y

#
# Wi-Fi / IEEE 802.15.4 coexistence (ESP32-C6)
#
CONFIG_ESP_COEX_SW_COEXIST_ENABLE=y
CONFIG_ESP_WIFI_SOFTAP_SUPPORT=y

#
# FreeRTOS
#
CONFIG_FREERTOS_HZ=1000

#
# mbedTLS — keep size down; LAN MQTT without TLS by default
#
CONFIG_MBEDTLS_AES_C=y
CONFIG_MBEDTLS_CCM_C=y
CONFIG_MBEDTLS_GCM_C=y
CONFIG_MBEDTLS_CERTIFICATE_BUNDLE=y
CONFIG_MBEDTLS_CERTIFICATE_BUNDLE_DEFAULT_CMN=y
CONFIG_MBEDTLS_CMAC_C=n
CONFIG_MBEDTLS_SHA512_C=n
CONFIG_MBEDTLS_ECP_DP_SECP384R1_ENABLED=n
CONFIG_MBEDTLS_ECP_DP_SECP521R1_ENABLED=n
CONFIG_MBEDTLS_ECP_DP_SECP256K1_ENABLED=n
CONFIG_MBEDTLS_ECP_DP_BP256R1_ENABLED=n
CONFIG_MBEDTLS_ECP_DP_BP384R1_ENABLED=n
CONFIG_MBEDTLS_ECP_DP_BP512R1_ENABLED=n
CONFIG_MBEDTLS_KEY_EXCHANGE_RSA=n
CONFIG_MBEDTLS_KEY_EXCHANGE_RSA_PSK=n
CONFIG_MBEDTLS_KEY_EXCHANGE_ECDHE_RSA=y

#
# MQTT
#
CONFIG_MQTT_PROTOCOL_311=y
CONFIG_MQTT_TRANSPORT_SSL=n
CONFIG_MQTT_TRANSPORT_WEBSOCKET=n
CONFIG_MQTT_TRANSPORT_WEBSOCKET_SECURE=n

#
# Gateway defaults (override via menuconfig / sdkconfig)
#
CONFIG_ZBGW_PRIMARY_CHANNEL=15
CONFIG_ZBGW_PERMIT_JOIN_SECONDS=180
# CONFIG_ZBGW_ZIGBEE_ONLY_DIAG is not set
# CONFIG_ZBGW_PAIR_BEFORE_WIFI is not set
# CONFIG_ZBGW_DEV_PAIR_TEST is not set
CONFIG_ZBGW_LED_GPIO=15
CONFIG_ZBGW_BOOT_GPIO=9
CONFIG_LWIP_MAX_SOCKETS=16
CONFIG_ZBGW_OTA_URL="https://homesolar.percolate.one/fw/zigbee-gateway.bin"
CONFIG_ZBGW_DIAG_URL="https://homesolar.percolate.one/api/diag/zbgw"
# CONFIG_ZBGW_OTA_CHECK_ON_BOOT is not set
CONFIG_ZBGW_WIFI_SSID="YOUR_WIFI_SSID"
CONFIG_ZBGW_WIFI_PASSWORD="YOUR_WIFI_PASSWORD"
CONFIG_ZBGW_MQTT_HOST="192.168.50.41"
CONFIG_ZBGW_MQTT_PORT=1883
CONFIG_ZBGW_MQTT_TOPIC_PREFIX="zigbee-gw"
```
